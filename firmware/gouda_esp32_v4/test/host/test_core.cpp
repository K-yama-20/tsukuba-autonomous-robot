// Host test of the firmware core (no hardware): TS-17 (manual priority, return after PRM-48), TS-18 (BT gap PRM-21),
// TS-19 (PC watchdog PRM-13 from the last VALID frame; invalid frames do not extend), TS-29 (golden vector shared with the
// Python codec), configuration validation, neutral at boot, DAC not written without a configuration.
// Configuration values come from build_config_trial.hpp generated by tools/gen_build_config.py --trial (desk values only).
#include <cassert>
#include <cstdio>
#include <cstring>
#include <string>
#include "gouda_v4/control.hpp"
#include "build_config_trial.hpp"

using namespace gouda_v4;
static int checks = 0;
#define CHECK(c) do { if (!(c)) { std::printf("FAIL %s:%d: %s\n", __FILE__, __LINE__, #c); return 1; } checks++; } while (0)

static const uint32_t TOKEN = 0x0123ABCDu;
static uint32_t seq = 0;
static void cmd(Core& c, uint32_t now, int16_t x, int16_t y, uint8_t flags = 1) { uint8_t f[kMaxFrame]; size_t n = encodeCommand(f, ++seq, now, TOKEN, x, y, flags); c.feed(f, n, now); }
static Applied step(Core& c, uint32_t now) { c.tick(now); return c.applied(); }
static bool hasEvent(const Core& c, uint8_t code) { for (size_t i = 0; i < c.eventCount(); i++) if (c.events()[i].code == code) return true; return false; }
static std::string hex(const uint8_t* p, size_t n) { std::string s; char b[3]; for (size_t i = 0; i < n; i++) { std::snprintf(b, 3, "%02x", p[i]); s += b; } return s; }

int main() {
    CHECK(build_config::trial && build_config::has_config);
    Config cfg = Config::fromItems(build_config::items); CHECK(cfg.valid());
    const uint16_t W = cfg.pc_command_watchdog_ms, BT = cfg.bt_report_timeout_ms, REL = cfg.manual_release_neutral_ms, N = cfg.dac_neutral_mv;

    // TS-29 golden vector (same as gouda_core/test/test_vehicle_core.py)
    { uint8_t f[kMaxFrame]; size_t n = encodeCommand(f, 3, 12345678, TOKEN, -3750, 6250, 1);
      CHECK(hex(f, n) == "a55a04020900030000004e61bc00cdab23015af16a1801adce");
      CHECK(crc16(reinterpret_cast<const uint8_t*>("123456789"), 9) == 0x29B1);
      Parser p; Frame fr; bool got = false; uint8_t junk[] = {0x00, 0xA5}; for (uint8_t b : junk) p.feed(b, fr);
      uint8_t bad[kMaxFrame]; memcpy(bad, f, n); bad[n - 1] ^= 0xFF; for (size_t i = 0; i < n; i++) p.feed(bad[i], fr);
      for (size_t i = 0; i < n; i++) got |= p.feed(f[i], fr);
      CHECK(got && fr.kind == COMMAND && fr.seq == 3 && fr.length == 9 && int16_t(get16(fr.payload + 4)) == -3750 && p.rejected >= 1); }

    // without configuration: DAC never written
    { Core c(1, nullptr, false, 0); Applied a = c.applied(); CHECK(a.source == SRC_NONE && a.reason == R_CONFIG_INVALID && !a.dac_written);
      uint16_t partial[10] = {0, 0, 0, 0, W, BT, 0, 0, 0, 0}; Config pc = Config::fromItems(partial); CHECK(!pc.valid()); }

    // boot: neutral, PC disabled; PC enable needs a neutral command
    { Core c(TOKEN, &cfg, false, 0); Applied a = step(c, 0); CHECK(a.source == SRC_NONE && a.dac_written && a.target_x_mv == N && a.target_y_mv == N && !c.pcEnabled());
      cmd(c, 0, 5000, 0); step(c, 0); CHECK(!c.pcEnabled() && c.applied().target_x_mv == N);
      cmd(c, 10, 0, 0); step(c, 10); CHECK(c.pcEnabled()); cmd(c, 20, 5000, 0); a = step(c, 20); CHECK(a.source == SRC_PC && a.target_x_mv > N && a.target_y_mv == N); }

    // TS-19
    { Core c(TOKEN, &cfg, false, 0); cmd(c, 0, 0, 0); step(c, 0); cmd(c, 100, 5000, 2000); CHECK(step(c, 100).source == SRC_PC);
      const uint32_t last_valid = 100; uint32_t t = last_valid + 1;
      while (t < last_valid + W + 200) {
          uint8_t f[kMaxFrame]; size_t n = encodeCommand(f, seq + 1, t, TOKEN, 5000, 2000, 1); f[n - 1] ^= 0xFF; c.feed(f, n, t);      // bad CRC
          n = encodeCommand(f, seq + 1, t, TOKEN ^ 1, 5000, 2000, 1); c.feed(f, n, t);                                            // wrong token
          n = encodeCommand(f, seq, t, TOKEN, 5000, 2000, 1); c.feed(f, n, t);                                                    // replayed sequence
          Applied a = step(c, t);
          if (t - last_valid < W) CHECK(a.source == SRC_PC); else { CHECK(a.source == SRC_NONE && a.target_x_mv == N && a.target_y_mv == N && !c.pcEnabled()); }
          t += 50;
      }
      CHECK(hasEvent(c, E_PC_DISABLED_STALE));
      cmd(c, t, 5000, 0); CHECK(!c.pcEnabled()); cmd(c, t + 1, 0, 0); CHECK(c.pcEnabled()); }

    // TS-17
    { Core c(TOKEN, &cfg, false, 0); c.btConnect(0); c.btReport(0, 0, 0); cmd(c, 0, 0, 0); step(c, 0); cmd(c, 10, 5000, 0); CHECK(step(c, 10).source == SRC_PC);
      uint32_t t = 20, lastManual = 0;
      while (t < 400) { c.btReport(0, 8000, t); cmd(c, t, 5000, 0); Applied a = step(c, t); CHECK(a.source == SRC_MANUAL && a.target_x_mv == N && a.target_y_mv > N); lastManual = t; t += 20; }
      CHECK(hasEvent(c, E_MANUAL_OVERRIDE_BEGIN));
      uint32_t start = t;
      while (t < start + REL + 100) { c.btReport(0, 0, t); cmd(c, t, 5000, 0); Applied a = step(c, t);
          if (t - lastManual < REL) { CHECK(a.source == SRC_NONE && a.reason == R_NEUTRAL_RECOVERY_WAIT && a.target_x_mv == N && a.target_y_mv == N); }
          else { CHECK(a.source == SRC_PC); }
          t += 20; }
      CHECK(c.pcEnabled() && hasEvent(c, E_MANUAL_OVERRIDE_END)); }

    // TS-18 (without and with PC commands)
    for (int withPc = 0; withPc < 2; withPc++) {
        Core c(TOKEN, &cfg, false, 0); c.btConnect(0); c.btReport(0, 0, 0); if (withPc) { cmd(c, 0, 0, 0); step(c, 0); }
        uint32_t t = 10, lastManual = 0;
        while (t < 200) { c.btReport(6000, 0, t); if (withPc) cmd(c, t, 0, 5000); CHECK(step(c, t).source == SRC_MANUAL); lastManual = t; t += 10; }
        const uint32_t lastReport = t - 10;
        while (t < lastReport + BT + REL + 100) { if (withPc) cmd(c, t, 0, 5000); Applied a = step(c, t);
            if (t - lastReport < BT) { CHECK(a.source == SRC_MANUAL); lastManual = t; }
            else if (t - lastManual < REL) { CHECK(a.source == SRC_NONE && a.target_x_mv == N && a.target_y_mv == N); if (withPc) CHECK(a.reason == R_NEUTRAL_RECOVERY_WAIT); }
            else { CHECK(a.source == (withPc ? SRC_PC : SRC_NONE)); }
            t += 10; }
        CHECK(hasEvent(c, E_BT_STALE));
        c.btReport(6000, 0, t); step(c, t); CHECK(!c.centered()); c.btReport(0, 0, t + 1); CHECK(c.centered());
    }

    // BT disconnect -> neutral; SET_CONFIG validation / generation; HELLO reply; periodic STATUS
    { Core c(TOKEN, &cfg, false, 0); c.btConnect(0); c.btReport(0, 0, 0); c.btReport(0, 9000, 10); CHECK(step(c, 10).source == SRC_MANUAL);
      c.btDisconnect(20); Applied a = step(c, 20); CHECK(a.source == SRC_NONE && a.target_x_mv == N && a.target_y_mv == N);
      Config bad = cfg; bad.dac_min_mv = bad.dac_max_mv; uint8_t p[kSetConfigPayload]; put32(p, TOKEN); bad.toBytes(p + 4);
      uint8_t f[kMaxFrame]; size_t n = encodeFrame(f, SET_CONFIG, ++seq, 30, p, sizeof p); c.txClear(); c.feed(f, n, 30);
      CHECK(c.configGeneration() == 0 && hasEvent(c, E_CONFIG_REJECTED) && c.config().dac_min_mv == cfg.dac_min_mv);
      cfg.toBytes(p + 4); n = encodeFrame(f, SET_CONFIG, ++seq, 31, p, sizeof p); c.feed(f, n, 31); CHECK(c.configGeneration() == 1 && c.configChanged());
      uint8_t h[4]; put32(h, 77); n = encodeFrame(f, HELLO, ++seq, 32, h, 4); c.txClear(); c.feed(f, n, 32);
      Parser pr; Frame fr; bool reply = false; for (size_t i = 0; i < c.txSize(); i++) if (pr.feed(c.txData()[i], fr) && fr.kind == HELLO_REPLY) { reply = true; CHECK(get32(fr.payload) == 77 && get32(fr.payload + 4) == TOKEN && fr.payload[8] == 1 && get16(fr.payload + 10) == 4); }
      CHECK(reply);
      c.txClear(); int statuses = 0; Parser pr2;
      for (uint32_t t = 100; t < 1100; t += 5) { c.tick(t);   // drained every tick, as main.cpp does
          for (size_t i = 0; i < c.txSize(); i++) if (pr2.feed(c.txData()[i], fr) && fr.kind == STATUS) { statuses++; CHECK(fr.length == kStatusPayload && (fr.payload[2] & F_CONFIG_VALID)); }
          c.txClear(); }
      CHECK(statuses == int(1000 / cfg.status_period_ms)); }

    std::printf("OK: %d checks\n", checks);
    return 0;
}
